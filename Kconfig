## config/west.yml
```yaml
manifest:
  remotes:
    - name: Kyle-Mendes
      url-base: https://github.com/Kyle-Mendes
  projects:
    - name: zmk
      remote: Kyle-Mendes
      revision: main
      import: app/west.yml
  self:
    path: config
```
